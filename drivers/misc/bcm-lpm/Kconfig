## drivers/misc/bcm-lpm/Kconfig
```kconfig
config BCM_BT_LPM
	tristate "Broadcom Bluetooth Low Power Mode"
	depends on SERIAL_MFD_HSU
	default m
	help
	   Select this module for Broadcom Bluetooth low power management.
```

## drivers/usb/dwc3/Kconfig
```kconfig
config USB_DWC3
	tristate "DesignWare USB3 DRD Core Support"
	depends on (USB || USB_GADGET) && HAS_DMA
	select USB_XHCI_PLATFORM if USB_SUPPORT && USB_XHCI_HCD
	help
	  Say Y or M here if your system has a Dual Role SuperSpeed
	  USB controller based on the DesignWare USB3 IP Core.

	  If you choose to build this driver is a dynamically linked
	  module, the module will be called dwc3.ko.

if USB_DWC3

choice
	bool "DWC3 Mode Selection"
	default USB_DWC3_DUAL_ROLE if (USB && USB_GADGET)
	default USB_DWC3_HOST if (USB && !USB_GADGET)
	default USB_DWC3_GADGET if (!USB && USB_GADGET)

config USB_DWC3_HOST
	bool "Host only mode"
	depends on USB=y || USB=USB_DWC3
	help
	  Select this when you want to use DWC3 in host mode only,
	  thereby the gadget feature will be regressed.

config USB_DWC3_GADGET
	bool "Gadget only mode"
	depends on USB_GADGET=y || USB_GADGET=USB_DWC3
	help
	  Select this when you want to use DWC3 in gadget mode only,
	  thereby the host feature will be regressed.

config USB_DWC3_DUAL_ROLE
	bool "Dual Role mode"
	depends on ((USB=y || USB=USB_DWC3) && (USB_GADGET=y || USB_GADGET=USB_DWC3))
	help
	  This is the default mode of working of DWC3 controller where
	  both host and gadget features are enabled.

endchoice

comment "Platform Glue Driver Support"

config USB_DWC3_PCI
	tristate "PCIe-based Platforms"
	depends on PCI
	default USB_DWC3
	help
	  If you're using the DesignWare Core IP with a PCIe, please say
	  'Y' or 'M' here.
	  One such PCIe-based platform is Synopsys' PCIe HAPS model of
	  this IP.

config USB_DWC3_OTG
	tristate "DWC3 OTG mode support"
	depends on USB && PCI
	select USB_OTG
	help
	  Say Y here to enable DWC3 OTG driver.
	  This driver implement OTG framework for DWC3 OTG controller.
	  Support role switch and charger detection feature. And maintain
	  one state machine. This driver should be work with platform
	  speical driver. Because every platform has their own hardware design.

config USB_DWC3_INTEL_MRFL
	tristate "DWC OTG 3.0 for Intel Merrifield platforms"
	depends on USB && USB_DWC3_OTG
	select USB_DWC3_DEVICE_INTEL
	help
	  Say Y here to enable DWC3 OTG driver for Intel Merrifield platforms.
	  It implement OTG feature on DWC3 OTG controller.
	  Support role switch and charger detection feature.
	  This driver is must be set if you want to enable host mode on Intel
	  Merrifield platforms.

config USB_DWC3_INTEL_BYT
	tristate "DWC OTG 3.0 for Intel Baytrail platforms"
	depends on USB && USB_DWC3_OTG
	select USB_DWC3_DEVICE_INTEL
	help
	  Say Y here to enable DWC3 OTG driver for Intel Baytrail platforms.
	  It implement OTG feature on DWC3 OTG controller.
	  Support role switch and charger detection feature.
	  This driver is must be set if you want to enable device mode on Intel
	  Baytrial platforms.

config USB_DWC3_DEVICE_INTEL
	bool "DWC3 Device Mode support on Intel platform"
	depends on USB_DWC3_OTG
	help
	  Support Device mode of DWC3 controller on Intel platform.
	  It implement device mode feature on DWC3 OTG controller.
	  This driver is must be set if you want to enable device mode for Intel
	  platforms(e.g Baytrail and Merrifield)

config USB_DWC3_HOST_INTEL
	bool "DWC3 Host Mode support on Intel Merrifield platform"
	depends on USB_DWC3_INTEL_MRFL
	help
	  Support Host mode of DWC3 controller on Intel Merrifield platform.
	  It is should be enable with DWC3 INTEL driver. Because Intel platform
	  use different design with standard USB_DWC3_HOST. So if you want to
	  enable host mode on Intel platform, then you have to enable this config.

comment "Debugging features"
config USB_DWC3_OMAP
	tristate "Texas Instruments OMAP5 and similar Platforms"
	depends on EXTCON && (ARCH_OMAP2PLUS || COMPILE_TEST)
	depends on OF
	default USB_DWC3
	help
	  Some platforms from Texas Instruments like OMAP5, DRA7xxx and
	  AM437x use this IP for USB2/3 functionality.

	  Say 'Y' or 'M' here if you have one such device

config USB_DWC3_EXYNOS
	tristate "Samsung Exynos Platform"
	depends on ARCH_EXYNOS && OF || COMPILE_TEST
	default USB_DWC3
	help
	  Recent Exynos5 SoCs ship with one DesignWare Core USB3 IP inside,
	  say 'Y' or 'M' if you have one such device.

config USB_DWC3_KEYSTONE
	tristate "Texas Instruments Keystone2 Platforms"
	depends on ARCH_KEYSTONE || COMPILE_TEST
	default USB_DWC3
	help
	  Support of USB2/3 functionality in TI Keystone2 platforms.
	  Say 'Y' or 'M' here if you have one such device

config USB_DWC3_ST
	tristate "STMicroelectronics Platforms"
	depends on ARCH_STI && OF
	default USB_DWC3
	help
	  STMicroelectronics SoCs with one DesignWare Core USB3 IP
	  inside (i.e. STiH407).
	  Say 'Y' or 'M' if you have one such device.

config USB_DWC3_QCOM
	tristate "Qualcomm Platforms"
	depends on ARCH_QCOM || COMPILE_TEST
	default USB_DWC3
	help
	  Recent Qualcomm SoCs ship with one DesignWare Core USB3 IP inside,
	  say 'Y' or 'M' if you have one such device.

comment "Debugging features"

config USB_DWC3_DEBUG
	bool "Enable Debugging Messages"
	help
	  Say Y here to enable debugging messages on DWC3 Driver.

config USB_DWC3_VERBOSE
	bool "Enable Verbose Debugging Messages"
	depends on USB_DWC3_DEBUG
	help
	  Say Y here to enable verbose debugging messages on DWC3 Driver.

config DWC3_HOST_USB3_LPM_ENABLE
	bool "Enable USB3 LPM Capability"
	depends on USB_DWC3_HOST=y || USB_DWC3_DUAL_ROLE=y
	default n
	help
	  Select this when you want to enable USB3 LPM with dwc3 xhci host.

endif
```

## sound/soc/intel/Kconfig
```kconfig
config SND_MFLD_MACHINE
	tristate "SOC Machine Audio driver for Intel Medfield MID platform"
	depends on INTEL_SCU_IPC && INTEL_SCU_IPC_UTIL && X86 && GPIO_LANGWELL
	depends on MSIC_GPADC
	select SND_SOC_SN95031
	select SND_SST_PLATFORM
	select SND_SST_MACHINE
	select SND_INTEL_SST
	default n
	help
          This adds support for ASoC machine driver for Intel(R) MID Medfield platform
          used as alsa device in audio subsystem in Intel(R) MID devices
          Say Y if you have such a device
	  If unsure select "N".

config SND_MRFLD_MACHINE
	tristate "SOC Machine Audio driver for Intel Merrifield MID platform"
	depends on INTEL_SCU_IPC && X86
	select SND_SOC_LM49453
	select SND_SOC_WM8994
	select MFD_CORE
	select MFD_WM8994
	select REGULATOR_WM8994
	select SND_SST_PLATFORM
	select SND_SST_MACHINE
	select SND_INTEL_SST
	select SND_EFFECTS_OFFLOAD
	default n
	help
	  This adds support for ASoC machine driver for Intel(R) MID Merrifield platform
          used as alsa device in audio substem in Intel(R) MID devices
          Say Y if you have such a device
          If unsure select "N".

config SND_INTEL_SST
       tristate

config SND_SST_PLATFORM
	tristate

config SND_SOC_COMMS_SSP
	depends on SND_INTEL_MID_I2S
	tristate "Use ASOC framework to drive AudioComms SSP BT and Modem"
	help
	  Sound SOC cards usually used for BT VOIP and MODEM MIXING use cases.
	  This will add devices for these uses cases in the list of alsa cards.
	  Say Y if you need these sound cards (BT chipset or Modem present).
	  Requires to enable the INTEL_MID_I2S low level SSP I2S driver.

config SST_MRFLD_DPCM
	bool "Use DPCM based Merrifield Machine Audio driver"
	default n
	help
	  This adds an option to enable the DPCM based MRFLD machine driver

config SND_SST_MACHINE
	tristate
```
